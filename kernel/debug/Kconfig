## kernel/debug/Kconfig
```kconfig
menu "Kernel debugging"

choice
	prompt "Log level"
	default	LOG_NOTE

config	LOG_ERR
	bool "Error"
config	LOG_WARN
	bool "Warn"
config	LOG_NOTE
	bool "Note"
config	LOG_INFO
	bool "Info"
config	LOG_DEBUG
	bool "Debug"

endchoice

config	LOG_LEVEL
	symbol
	default LOG_LEVEL_ERR   if LOG_ERR
	default LOG_LEVEL_WARN  if LOG_WARN
	default LOG_LEVEL_NOTE  if LOG_NOTE
	default LOG_LEVEL_INFO  if LOG_INFO
	default LOG_LEVEL_DEBUG if LOG_DEBUG
	
endmenu
```

## kernel/time/Kconfig
```kconfig
config LPUSEC_FIXED
	bool "Fixed loops-per-usec"
	default n

config LPUSEC_MULT
	int "loops-per-usec mult"
	depends on LPUSEC_FIXED
	default 1

config LPUSEC_SHIFT
	int "loops-per-usec shift"
	depends on LPUSEC_FIXED
	default 0
```

## mm/Kconfig
```kconfig
menu "Memory Management"

config NOMMU
	bool
	default n
config MMU
	def_bool !NOMMU

config MM_PAGE
	bool "Manage memory into pages"
	default y

config SLAB
	bool "Slab-like allocator"
	default y

endmenu
```

## net/Kconfig
```kconfig
menuconfig NET
	bool "Networking"

config	NET_STATS
	bool "network statistics"
	depends on NET
	default n

config	ETHERNET
	bool "Ethernet support"
	depends on NET
	default y
```

## tests/Kconfig
```kconfig
menu "Testing"

config	MEMTESTER
	bool "memtester"

config	MEMTESTER_ADDR
	hex "memtester addr"
	depends on MEMTESTER
	default VIRT_ADDR

config	MEMTESTER_SIZE
	hex "memtester size"
	depends on MEMTESTER
	default PHYS_SIZE

config	MEMTESTER_FULL
	bool "memtester full"
	depends on MEMTESTER
	default y

config	MEMTESTER_PERF
	bool "memtester perf"
	depends on MEMTESTER
	default y

endmenu
```
