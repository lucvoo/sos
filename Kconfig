## Kconfig
```kconfig
mainmenu "OS configuration"

choice
	prompt "Architecture"
	default	ARCH_ARM

config ARCH_ARM
	bool "ARM"

config ARCH_MIPS
	bool "MIPS"

endchoice


if ARCH_ARM
source arch/arm/Kconfig
endif
if ARCH_MIPS
source arch/mips/Kconfig
endif


menu "Build options"

config BUG
	bool "BUG() support"
	default y

config GC_SECTIONS
	bool "Sections GC"

config GC_SECTIONS_SHOW
	bool "Show sections GCed"
	depends on GC_SECTIONS

config	REMOVE_INIT_SECTIONS
	bool "Remove init sections when not needed anymore"
	default y

config	CROSS_COMPILE
	symbol "Cross compile prefix"

endmenu


menu "OS options"

config	NEED_INTERRUPT_STACK
	bool "is an interrupt stack needed?"
	default n

config	INTERRUPT_STACK_SIZE
	int "Interrupt stack size"
	depends on NEED_INTERRUPT_STACK
	default 4096

config	EXCEPTION_STACK_SIZE
	int "Exception stack size"
	default 4096

config	STARTUP_STACK_SIZE
	int "startup stack size"
	depends on !FIXED_STACKS
	default 4096

config	STACK_ALIGNMENT
	int "Stacks alignment"
	default 16

config	NR_THREAD_PRIORITY
	int "Number of threads priority levels"
	range 2 32
	default 32

config	FIXED_STACKS
	bool "Use the same size for all stacks"
	default y

config	FIXED_STACKS_SHIFT
	int "Size of the stacks, in power of 2"
	depends on FIXED_STACKS
	range 12 14
	default 14

config	SOFTIRQ
	bool "Need softirq?"
	default n

config	KSOFTIRQ
	bool "Use a specific thread for delaying softirq"
	depends on SOFTIRQ
	default n
	
config	DSR
	bool "Want DSR?"
	depends on SOFTIRQ
	default n

config	HAS_SMP
	bool
	default n

config	SMP
	bool "SMP support"
	depends on HAS_SMP
	default y

config	HZ
	int "tick frequency"
	default 100

config	BOOT
	bool "Direct boot, without a bootloader"
	default y

endmenu

source mm/Kconfig
source net/Kconfig
source kernel/time/Kconfig

source drivers/Kconfig

source kernel/debug/Kconfig
```

## arch/arm/Kconfig
```kconfig
config ARCH
	symbol
	default arm


config	ARM720T
	bool
	select ARMV4T

config	ARM7TDMI
	bool
	select ARMV4T

config	ARM926E
	bool
	select ARMV5

config	ARM926EJS
	bool
	select ARMV5
	select ARMV5TE

config	CORTEX_A7
	bool
	select ARMV7A
config	CORTEX_A8
	bool
	select ARMV7A
config	CORTEX_A9
	bool
	select ARMV7A
config	CORTEX_A15
	bool
	select ARMV7A

config	CORTEX_M4
	bool
	select ARMV7M

config	ARM_TZ
	bool
config	ARMV4T
	bool
config	ARMV5
	bool
config	ARMV5T
	bool
	select ARMV5
config	ARMV5TE
	bool
	select ARMV5T
config	ARMV6
	bool
config	ARMV6K
	bool
	select ARMV6
config	ARMV7A
	bool
	select ARM_TZ
config	ARMV7M
	select NOMMU
	select HAS_DIV32
	bool
config	ARMV7
	bool
	default ARMV7A || ARMV7M
config	ARMVA
	bool
	default !ARMV7M

config	ARM_ARCH
	int
	default 4 if ARMV4T
	default 5 if ARMV5
	default 6 if ARMV6
	default 7 if ARMV7A
	default 7 if ARMV7M

config	BITS
	int
	default 32

source arch/arm/Kconfig.mach
source arch/arm/Kconfig.socs


menu "ARM options"

comment "Memory"
config	VIRT_ADDR
	hex "Main RAM virtual address"
	default 0x80000000

config	TEXT_OFFSET
	hex "Start of kernel image relatively to the start of the RAM"
	default 0x00008000

config	XIP
	bool "XIP (kernel run from ROM or flash)"
config	XIP_PADDR
	hex "XIP physical address"
	depends on XIP
	default 0x80000000
config	XIP_VADDR
	hex "XIP virtual address" if !NOMMU
	depends on XIP
	default XIP_PADDR         if  NOMMU
	default VIRT_ADDR	  if !NOMMU
config	XIP_SIZE
	hex "XIP size"
	depends on XIP
	default 0x00100000

comment "Misc"
config	THUMB2
	bool "compile to thumb2" if !ARMV7M
	depends on ARMV7 || ARMV7M
	default ARMV7M

config	HAS_VBAR
	bool "Has VBAR"
	depends on ARMV6K || ARMV7
config	HIGH_VECTORS
	bool "Use high vectors"
	depends on !HAS_VBAR && !ARMV7M
	default y

config	NVIC_NBR_IRQ
	int "NVIC's IRQ number"
	depends on ARMV7M
	default 96

endmenu
```

## arch/arm/Kconfig.mach
```kconfig
choice
	prompt "Platform"
	default	MACH_BEAGLEBONE

config MACH_ARM_GENERIC
	bool "generic"
config MACH_BEAGLEBONE
	bool "BeagleBone"

config MACH_CUBIEBOARD4
	bool "Cubieboard"

config MACH_ORANGEPI_ZERO
	bool "Orange Pi Zero"

config MACH_RASPBERRY_PI
	bool "Raspberry-pi"

config MACH_STM32
	bool "STM32 family"

config MACH_UDOO_NEO
	bool "UDOO Neo"

endchoice

if MACH_BEAGLEBONE
source arch/arm/mach-beaglebone/Kconfig
endif
if MACH_CUBIEBOARD4
source arch/arm/mach-cubieboard4/Kconfig
endif
if MACH_RASPBERRY_PI
source arch/arm/mach-raspberry-pi/Kconfig
endif
if MACH_STM32
source arch/arm/mach-stm32/Kconfig
endif
if MACH_UDOO_NEO
source arch/arm/mach-udoo-neo/Kconfig
endif
if MACH_ORANGEPI_ZERO
source arch/arm/mach-orangepi-zero/Kconfig
endif
```

## arch/arm/Kconfig.socs
```kconfig
config SOC_AM335X
	bool
config SOC_BCM2835
	bool
config SOC_BCM283X
	bool
	default SOC_BCM2835
config SOC_IMX6
	bool
config SOC_STM32
	bool
config SOC_SUNXI
	bool
config SOC_SUNXI_A80
	bool
	select SOC_SUNXI
config SOC_SUNXI_H3
	bool
	select SOC_SUNXI

menu "SoC options"
if SOC_BCM283X
source arch/arm/soc-bcm283x/Kconfig
endif
if SOC_IMX6
source arch/arm/soc-imx6/Kconfig
endif
if SOC_STM32
source arch/arm/soc-stm32/Kconfig
endif
if SOC_SUNXI
source arch/arm/soc-sunxi/Kconfig
endif
endmenu
```

## arch/arm/mach-beaglebone/Kconfig
```kconfig
config MACH
	symbol
	default beaglebone

config	MACH_PARAMS
	bool
	default y
	select CORTEX_A8
	select SOC_AM335X

config PHYS_ADDR
	hex
	default 0x80000000
config PHYS_SIZE
	hex
	default 0x10000000

config EARLY_DEBUG_ADDR
	hex
	default 0x44e00000
```

## arch/arm/mach-cubieboard4/Kconfig
```kconfig
config MACH
	symbol
	default cubieboard4

config	MACH_PARAMS
	bool
	default y
	select SOC_SUNXI_A80

config PHYS_ADDR
	hex
	default 0x20000000

config PHYS_SIZE
	hex
	default 0x80000000

config	EARLY_DEBUG_ADDR
	hex
	default 0x07000000
```

## arch/arm/mach-nanopi-neo/Kconfig
```kconfig
config MACH
	symbol
	default nanopi-neo

config	MACH_PARAMS
	bool
	default y
	select SOC_SUNXI_H3

config PHYS_ADDR
	hex
	default 0x40000000

config PHYS_SIZE
	hex
	default 0x20000000

config	EARLY_DEBUG_ADDR
	hex
	default 0x01C28000
```

## arch/arm/mach-orangepi-zero/Kconfig
```kconfig
config MACH
	symbol
	default orangepi-zero

config	MACH_PARAMS
	bool
	default y
	select SOC_SUNXI_H3

config PHYS_ADDR
	hex
	default 0x40000000

config PHYS_SIZE
	hex
	default 0x10000000

config	EARLY_DEBUG_ADDR
	hex
	default 0x01C28000
```

## arch/arm/mach-raspberry-pi/Kconfig
```kconfig
config MACH
	symbol
	default raspberry-pi if MACH_RASPBERRY_PI

config	MACH_PARAMS
	bool
	default y
	select SOC_BCM2835
```

## arch/arm/mach-stm32/Kconfig
```kconfig
config MACH
	symbol
	default stm32

config	MACH_PARAMS
	bool
	default y
	select SOC_STM32

choice
	prompt "Boards selection"

	config STM32F103_BLUEPILL
	bool "stm32f103-bluepill"
	select STM32F10X
	select STM32_HSE_8MHZ

	config STM32F429_DISCO
	bool "stm32f429-disco"
	select STM32F429
	select STM32_HSE_8MHZ
	select SDRAM

	config STM32F746_DISCO
	bool "stm32f746-disco"
	select STM32F746
	select STM32_HSE_25MHZ

endchoice
```

## arch/arm/mach-udoo-neo/Kconfig
```kconfig
config MACH
	symbol
	default udoo-neo

config	MACH_PARAMS
	bool
	default y
	select SOC_IMX6
	select SOC_IMX6SX

config PHYS_ADDR
	hex
	default 0x80000000

config PHYS_SIZE
	hex
	default 0x40000000

config	EARLY_DEBUG_ADDR
	hex
	default 0x02000000
```

## arch/arm/mach-xxx/Kconfig
```kconfig
config MACH_PARAMS
	bool
	default y
	select ARM7TDMI

config VIRT_ADDR
	hex "Kernel virtual start address"
	default 0xC0000000

config TEXT_OFFSET
	hex "Kernel text offset"
	default 0x00008000
```

## arch/arm/soc-bcm283x/Kconfig
```kconfig
config	SOC
	symbol
	default bcm283x

config	SOC_BCM2835_PARAMS
	bool
	default SOC_BCM2835
	select ARM1176JZFS

config PHYS_ADDR
	hex
	default 0x00000000
config PHYS_SIZE
	hex "RAM size"
	default 0x0c000000
```

## arch/arm/soc-imx6/Kconfig
```kconfig
config	SOC
	symbol
	default imx6

config	SOC_PARAMS
	bool
	default y
	select CORTEX_A9
	select ARM_GIC


choice
	prompt "IMX6 variant"

config	SOC_IMX6SX
	bool "IMX6SX"

endchoice
```

## arch/arm/soc-stm32/Kconfig
```kconfig
config  SOC
        symbol
        default stm32

config	SOC_PARAMS
	bool
	default y

config PHYS_ADDR
	hex
	default 0x20000000

config PHYS_SIZE
	hex "SRAM size"
	default 0x00020000

config LOWPOWER_DEBUG
	bool "Allow debugging while in low-power mode"
	default y

config	SDRAM
	bool

# models
config	STM32F10X
	bool
	select CORTEX_M3
config	STM32F4XX
	bool
	select CORTEX_M4
config	STM32F7XX
	bool
	select CORTEX_M7
config	STM32F407
	bool
	select STM32F4XX
config	STM32F429
	bool
	select STM32F4XX
config	STM32F746
	bool
	select STM32F7XX

# clock configuration

config	STM32_HSE_8MHZ
	bool
config	STM32_HSE_12MHZ
	bool
config	STM32_HSE_25MHZ
	bool

config	STM32_HSE_FREQ
	int
	default 8 if STM32_HSE_8MHZ
	default 12 if STM32_HSE_12MHZ
	default 25 if STM32_HSE_25MHZ
	default 0

config	STM32_PLL_MAX
	int
	default  72 if STM32F10X
	default 168 if STM32F407
	default 180 if STM32F429
	default 216 if STM32F746
config	STM32_CLK_MAX
	int
	default  72 if STM32F10X
	default 168 if STM32F407
	default 180 if STM32F429
	default 216 if STM32F746


choice
	prompt "Diagnostic port"

config	STM32_DIAG_NONE
	bool "None"

config	STM32_DIAG_USART1_PA9_PA10
	bool "USART1 on PA9 & PA10"

config	STM32_DIAG_USART3_PB10_PB11
	bool "USART3 on PB10 & PB11"

endchoice
config	STM32_DIAG
	bool
	default !STM32_DIAG_NONE
```

## arch/arm/soc-sunxi-a80/Kconfig
```kconfig
config	SOC
	symbol
	default sunxi-a80

config	SOC_PARAMS
	bool
	default y
	select CORTEX_A7
	select ARM_GIC
	select HAS_SMP
	select CCI400 if SMP
```

## arch/arm/soc-sunxi/Kconfig
```kconfig
config	SOC
	symbol
	default sunxi

config SMP_SUNXI_MC
	bool

config	SOC_PARAMS_A80
	bool
	default SOC_SUNXI_A80
	select CORTEX_A7
	select ARM_GIC
	select HAS_SMP
	select CCI400 if SMP
	select SMP_SUNXI_MC if SMP
```

## arch/arm/socs/stm32/Kconfig
```kconfig
config	SOC_PARAMS
	bool
	default y
	select CORTEX_M4

config PHYS_ADDR
	hex
	default 0x20000000
```

## arch/arm64/Kconfig
```kconfig
config ARCH
	symbol
	default arm64

config	ARMV8
	bool
	default y
	select HAS_DIV32
	select HAS_DIV64
	select BUG

config	ARM_ARCH
	int
	default 8 if ARMV8

config	BITS
	int
	default 64


config	CPU_A53
	bool
	select ARMV8

config	CPU_A57
	bool
	select ARMV8


menu "ARM64 options"

config	ARM64_BOOT
	bool "Enable stuff a bootloader should do"

config	ARM64_DROP_EL3_EL1
	bool "Drop from el3 to el1"
	depends on ARM64_BOOT

comment "Memory"

choice
	prompt "Page size"
	default PAGESIZE_4K

config	PAGESIZE_4K
	bool "4K"

config	PAGESIZE_16K
	bool "16K"
	depends on BROKEN

config	PAGESIZE_64K
	bool "64K"
	depends on BROKEN
endchoice

config	PAGE_BITS
	int
	default 12 if PAGESIZE_4K
	default 14 if PAGESIZE_16K
	default 16 if PAGESIZE_64K


config	VA_BITS
	int "Virtual Address range"
	depends on !PAGESIZE_16K || BROKEN
	depends on !PAGESIZE_64K || BROKEN
	range 25 48
	default 39 if PAGESIZE_4K


config	PHYS_ADDR
	hex "Main RAM physical address"

config	PHYS_SIZE
	hex "Main RAM size"

config	ARM64_NOMMU
	bool "MMU disabled"
	default n
	select NOMMU

config	VIRT_ADDR
	hex "non-standard virtual address"
	depends on ARM64_NOMMU
	default PHYS_ADDR

config	TEXT_OFFSET
	hex "Start of kernel image relatively to the start of the RAM"
	default 0x0		if NOMMU
	default 0x200000	if   MMU
	help
	  See Linux's arm64 booting requirements
	  (Documentation/arm64/booting.txt).

endmenu

source arch/arm64/Kconfig.mach
source arch/arm64/Kconfig.socs


menu "ARM64 options"

comment "Generic Timer"
config	GENERIC_TIMER
	bool "Generic timer"
	default y

config	CNTFRQ
	int "Generic timer frequency"
	depends on GENERIC_TIMER

endmenu
```

## arch/arm64/Kconfig.mach
```kconfig
choice
	prompt "Platform"
	default	MACH_PINE64

config MACH_ARM64_GENERIC
	bool "generic"
config MACH_PINE64
	bool "Pine64"

endchoice

if MACH_PINE64
source arch/arm64/mach-pine64/Kconfig
endif
```

## arch/arm64/Kconfig.socs
```kconfig
menu "SoC options"

config SOC_ALLWINNER
	bool
config SOC_A64
	bool
	select SOC_ALLWINNER

if SOC_A64
source arch/arm64/soc-A64/Kconfig
endif

endmenu
```
