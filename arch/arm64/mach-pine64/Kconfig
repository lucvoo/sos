## arch/arm64/mach-pine64/Kconfig
```kconfig
config MACH
	symbol
	default pine64

config	MACH_PARAMS
	bool
	default y
	select SOC_A64
```

## arch/arm64/soc-A64/Kconfig
```kconfig
config  SOC
        symbol
        default A64

config	SOC_PARAMS
	bool
	default y
	select CPU_A53
	select ARM_GIC
```

## arch/mips/Kconfig
```kconfig
config ARCH
	symbol
	default mips


config	ARCH_PARAMS
	bool
	default ARCH_MIPS
	select DMA_STREAMING

config	ENDIAN_BIG
	bool
config	ENDIAN_LITTLE
	bool
config	CPU_HAS_SYNC
	bool
config	WAIT_BROKEN
	bool

config	MIPS32
	bool

config	CPU_MIPS32R2
	bool "MIPS32 Release 2"
	select MIPS32
	select CPU_HAS_SYNC

config	CPU_24KC
	bool "24Kc"
	select CPU_MIPS32R2

config	CPU_INTERAPTIV
	bool
	select CPU_MIPS32R2
	select MIPS_GIC
	select MIPS_CPS
	select MIPS_CM

config	BITS
	int
	default 32 if MIPS32

config	C0_COUNTER_DISABLED
	bool
	default n

config	MIPS_CM
	bool "MIPS Coherence Manager" if n
config	MIPS_CPC
	bool "MIPS Cluster Power Control" if n
config	MIPS_CPS
	bool "MIPS Coherent Processing System" if n
	select MIPS_CPC
	select MIPS_CM

config	SMP_CPS
	bool
	depends on MIPS_CPS
	depends on SMP
	default y


source arch/mips/Kconfig.mach
source arch/mips/Kconfig.socs

menu "MIPS options"

config	ABI_EABI
	bool "Use EABI"
	default y

comment "Memory"
config	PHYS_ADDR
	hex
	default 0x80000000

config	VIRT_ADDR
	hex
	default 0x80000000

config	TEXT_OFFSET
	hex "Start of kernel image relatively to the start of the RAM"
	default 0x00008000

config	LOAD_OFFSET
	hex "kernel image's load offset"
	default TEXT_OFFSET

endmenu
```

## arch/mips/Kconfig.mach
```kconfig
choice
	prompt "Boards"
	default	MACH_CI20

config MACH_CI20
	bool "ci20"
config MACH_CI40
	bool "ci40"
config MACH_OMEGA
	bool "Onion's Omega"

endchoice

if MACH_CI20
source arch/mips/mach-ci20/Kconfig
endif
if MACH_CI40
source arch/mips/mach-ci40/Kconfig
endif
if MACH_OMEGA
source arch/mips/mach-omega/Kconfig
endif
```

## arch/mips/Kconfig.socs
```kconfig
config SOC_AR933X
	bool
if SOC_AR933X
source arch/mips/soc-ar933x/Kconfig
endif


config SOC_JZ4780
	bool
config SOC_CXT200
	bool


if SOC_JZ4780
source arch/mips/soc-jz4780/Kconfig
endif
if SOC_CXT200
source arch/mips/soc-cxt200/Kconfig
endif
```

## arch/mips/mach-ci20/Kconfig
```kconfig
config MACH
	symbol
	default ci20

config	MACH_PARAMS
	bool
	default y
	select CPU_MIPS32R2
	select SOC_JZ4780
	select ENDIAN_LITTLE

config PHYS_ADDR
	hex
	default 0x80000000
config PHYS_SIZE
	hex
	default 0x10000000
```

## arch/mips/mach-ci40/Kconfig
```kconfig
config MACH
	symbol
	default ci40

config	MACH_PARAMS
	bool
	default y
	select SOC_CXT200
```

## arch/mips/mach-omega/Kconfig
```kconfig
config MACH
	symbol
	default omega

config	MACH_PARAMS
	bool
	default y
	select SOC_AR933X

config PHYS_ADDR
	hex
	default 0x80000000
config PHYS_SIZE
	hex
	default 0x04000000
```

## arch/mips/soc-ar933x/Kconfig
```kconfig
menu "AR933x"

config	SOC
	symbol
	default	ar933x

config	SOC_PARAMS
	bool
	default y
	select WAIT_BROKEN
	select CPU_24KC
	select ENDIAN_BIG

endmenu
```

## arch/mips/soc-cxt200/Kconfig
```kconfig
menu "cXT200"

config	SOC
	symbol
	default	cxt200

config	SOC_PARAMS
	bool
	default y
	select HAS_SMP
	select ENDIAN_LITTLE
	select CPU_INTERAPTIV

config PHYS_ADDR
	hex
	default 0x00000000
config PHYS_SIZE
	hex
	default 0x10000000

endmenu
```

## arch/mips/soc-jz4780/Kconfig
```kconfig
menu "JZ4780"

config	SOC
	symbol
	default	jz4780

config	SOC_PARAMS
	bool
	default y
	select HAS_SMP
	select WAIT_BROKEN
	select C0_COUNTER_DISABLED

config	JTAG_ENABLE
	bool "Enable JTAG"
	default y

endmenu
```

## arch/mips/socs/Kconfig
```kconfig
config SOC_JZ4780
	bool


if SOC_JZ4780
source arch/mips/socs/jz4780/Kconfig
endif
```

## arch/mips/socs/jz4780/Kconfig
```kconfig
config	SOC
	symbol
	default	jz4780

config	SOC_PARAMS
	bool
	default y
	select HAS_SMP
	select WAIT_BROKEN

config	JTAG_ENABLE
	bool "Enable JTAG"
	default y
```

## drivers/Kconfig
```kconfig
menu "Drivers"

source drivers/gpio/Kconfig
source drivers/irq/Kconfig
source drivers/net/Kconfig
source drivers/uart/Kconfig
source drivers/mmc/Kconfig

endmenu
```

## drivers/net/Kconfig
```kconfig
menuconfig NET_DRIVERS
	bool "Network drivers"
	depends on NET

source drivers/net/ethernet/Kconfig
```

## drivers/net/ethernet/Kconfig
```kconfig
menuconfig ETHERNET_DRIVERS
	bool "Ethernet drivers"
	depends on NET_DRIVERS
	depends on ETHERNET
	default y

config	DM9000
	depends on ETHERNET_DRIVERS
	bool "DM9000 (Davicom)"
```

## drivers/timer/Kconfig
```kconfig
menu "Timers"

source kernel/time/Kconfig


config	ARM_GENERIC_TIMER
	bool "ARM generic timer"
	depends on ARMV7A || ARCH_ARM64
	default n

config	CNTFRQ
	int "Generic timer frequency"
	depends on ARM_GENERIC_TIMER


config	MIPS_ARCH_TIMER
	bool "MIPS architectural timer"
	depends on ARCH_MIPS
	depends on !C0_COUNTER_DISABLED
	default y

config	MIPS_GIC_TIMER
	bool "MIPS GIC's timer"
	depends on MIPS_GIC
	default y

endmenu
```

## drivers/uart/Kconfig
```kconfig
menuconfig UART
	bool "UART"
	default y

config UART_16550
	bool "16550 & compatible"
	depends on UART
	default n
```
